## boards/shields/corne-dongle/Kconfig.defconfig
```kconfig
if SHIELD_CORNE_CENTRAL_LEFT

config ZMK_SPLIT_ROLE_CENTRAL
    default y

config ZMK_KEYBOARD_NAME
    default "Corne Left"

endif


if SHIELD_CORNE_DONGLE

config ZMK_SPLIT_ROLE_CENTRAL
    default y

config ZMK_KEYBOARD_NAME
    default "Corne Dongle"

config ZMK_USB
    default y

endif


if SHIELD_CORNE_LEFT || SHIELD_CORNE_RIGHT

config ZMK_SPLIT
    default y

endif
```

## boards/shields/matze/Kconfig.defconfig
```kconfig
if SHIELD_MATZE_CENTRAL_LEFT

config ZMK_KEYBOARD_NAME
    default "Matze Left"

config ZMK_SPLIT_ROLE_CENTRAL
    default y

endif

if SHIELD_MATZE_DONGLE

config ZMK_KEYBOARD_NAME
	default "Matze Dongle"

config ZMK_SPLIT_BLE_ROLE_CENTRAL
	default y

config ZMK_USB
	default y

endif

if SHIELD_MATZE_LEFT || SHIELD_MATZE_RIGHT || SHIELD_MATZE_DONGLE || SHIELD_MATZE_CENTRAL_LEFT

config ZMK_SPLIT
	default y

config ZMK_BLE
	default y

endif
```

## boards/shields/matze/Kconfig.shield
```kconfig
# Copyright (c) 2020 Pete Johanson
# SPDX-License-Identifier: MIT

config SHIELD_MATZE_LEFT
    def_bool $(shields_list_contains,matze_left)

config SHIELD_MATZE_CENTRAL_LEFT
    def_bool $(shields_list_contains,matze_central_left)

config SHIELD_MATZE_RIGHT
    def_bool $(shields_list_contains,matze_right)

config SHIELD_MATZE_DONGLE
    def_bool $(shields_list_contains,matze_dongle)
```
